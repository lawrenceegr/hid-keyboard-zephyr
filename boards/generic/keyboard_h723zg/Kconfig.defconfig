## boards/generic/keyboard_h723zg/Kconfig.keyboard_h723zg
```kconfig
# Copyright (c) 2026 Lawrence Langat <lawrencelangatmi@gmail.com>
# SPDX-License-Identifier: Apache-2.0

config BOARD_KEYBOARD_H723ZG
	select SOC_STM32H723XX
```

## boards/generic/keyboard_h723zg/board.yml
```yaml
board:
  name: keyboard_h723zg
  full_name: Keyboard H723ZG
  vendor: generic
  socs:
    - name: stm32h723xx
```

## build/Kconfig/Kconfig.shield
```kconfig
osource "/home/marcus/zephyrproject/workspace/hid-keyboard/boards/shields/*/Kconfig.shield"
```

## build/Kconfig/boards/Kconfig.defconfig.tmp
```kconfig
# Load Zephyr board defconfig descriptions.
osource "/home/marcus/zephyrproject/workspace/hid-keyboard/boards/generic/keyboard_h723zg/Kconfig.defconfig"
```

## build/Kconfig/boards/Kconfig.keyboard_h723zg
```kconfig
# Load board Kconfig descriptions.
osource "/home/marcus/zephyrproject/workspace/hid-keyboard/boards/generic/keyboard_h723zg/Kconfig.keyboard_h723zg"
```

## build/Kconfig/boards/Kconfig.sysbuild.tmp
```kconfig
# Load Sysbuild board Kconfig descriptions.
osource "/home/marcus/zephyrproject/workspace/hid-keyboard/boards/generic/keyboard_h723zg/Kconfig.sysbuild"
```
